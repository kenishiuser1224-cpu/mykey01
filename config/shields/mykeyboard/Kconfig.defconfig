## config/shields/mykeyboard/Kconfig.defconfig
```kconfig
if SHIELD_MYKEYBOARD

config ZMK_KEYBOARD_NAME
    default "mykeyboard"

config ZMK_KSCAN_DEBOUNCE_PRESS_MS
    default 5

config ZMK_KSCAN_DEBOUNCE_RELEASE_MS
    default 5

endif
```
